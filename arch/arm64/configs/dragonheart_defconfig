## drivers/backlight/Kconfig
```kconfig
source "drivers/backlight/aw99703/Kconfig"

source "drivers/backlight/sm5350/Kconfig"
```

## drivers/backlight/sm5350/Kconfig
```kconfig
config LEDS_SM5350
	tristate "SM5350 LED driver"
	default n
	help
	  Say Y here if you have SM5350 LED in
	  your system.

	  If unsure, say N.

	  To compile this driver as a module, choose M here: the
	  module will be called sm5350_bl.
```

## drivers/input/misc/chipone_fps/Kconfig
```kconfig
config CHIPONE_FPS
	tristate "Chipone Fingerprint Driver"
	default n
	help
	  Say Y here if you wish to include support for Chipone fingerprint sensor.

	  If unsure, say N.

	  To compile this driver as a module, choose M here: the module will be called fpsensor_mtk_spi.

config CHIPONE_GPIO_CTRL_VDD
	bool "Chipone GPIO control"
	default n
	help
	  Say Y here if you wish to use GPIO control for Chipone fingerprint sensor.

config CHIPONE_PMIC_CTRL_VDD
	bool "Chipone PMIC control"
	default n
	help
	  Say Y here if you wish to use GPIO control for Chipone fingerprint sensor.

config CHIPONE_MTK_KERNEL5XX_WAKE_TYPE
	bool "Chipone Kernel 5.x wakelock type"
	default n
	help
	  Say Y here if you wish to use Kernel 5.x wakelock types for Chipone fingerprint sensor.
```

## drivers/input/misc/goodix_fps_mmi/Kconfig
```kconfig
config GOODIX_FPS_MMI
	tristate "Goodix MMI Fingerprint Driver"
	default n
	help
	  Say Y here if you wish to include support for Goodix MMI fingerprint sensor.

	  If unsure, say N.

	  To compile this driver as a module, choose M here: the module will be called goodix_fps_tee.
```

## drivers/input/touchscreen/focaltech_0flash_mmi_v2/Kconfig
```kconfig
config TOUCHSCREEN_FOCALTECH_0FLASH_V2_MMI
	tristate "FocalTech Touchscreen Driver"
	default n
	help
	  Say Y here if you wish to include support for FocalTech touch panel.

	  If unsure, say N.

	  To compile this driver as a module, choose M here: the module will be called focaltech_0flash_mmi_v2.

if TOUCHSCREEN_FOCALTECH_0FLASH_V2_MMI

config FTS_MTK_CHECK_PANEL
	bool "FocalTech panel check for Mediatek devices"
	default n
	help
	  Say Y here if you wish to include support for FocalTech panel check for Mediatek devices.

config FTS_IC_NAME_FT8725
	bool "Support FocalTech ft8725 touch panel IC"
	default n
	help
	  Say Y here if you wish to include support for FocalTech ft8725 touch panel IC.

config FTS_IRQ_DIS_FOR_RESET
	bool "Disable IRQ on certain cases in FocalTech touch panel"
	default n
	help
	  Say Y here if you wish to include support to disable IRQ on certain cases in FocalTech touch panel.

config FTS_MTK_SPI
	bool "Update SPI timing on FocalTech touch panel"
	default n
	help
	  Say Y here if you wish to include support to update SPI timing on FocalTech touch panel.

config FTS_LAST_TIME
	bool "Get last touch timestamp on FocalTech touch panel"
	default n
	help
	  Say Y here if you wish to include support to get last touch timestamp on FocalTech touch panel.

config INPUT_FOCALTECH_0FLASH_MMI_ENABLE_DOUBLE_TAP
	bool "Support double tap on FocalTech touch panel"
	default n
	help
	  Say Y here if you wish to include support for double tap on FocalTech touch panel.

endif
```

## drivers/input/touchscreen/ilitek_v3_mmi/Kconfig
```kconfig
config TOUCHSCREEN_ILITEK_CHIPSET
	tristate "IliTek Touchscreen Driver"
	default n
	help
	  Say Y here if you wish to include support for IliTek touch panel.

	  If unsure, say N.

	  To compile this driver as a module, choose M here: the module will be called ilitek_v3_mmi.

if TOUCHSCREEN_ILITEK_CHIPSET

config INPUT_ILI_ENABLE_DOUBLE_TAP
	bool "Support double tap on IliTek touch panel"
	depends on BOARD_USES_DOUBLE_TAP_CTRL
	default n
	help
	  Say Y here if you wish to include support for double tap on IliTek touch panel.

config ILITEK_RESUME_BY_DDI
	bool "Enable resume_by_ddi for IliTek touch panel"
	default n
	help
	  Say Y here if you wish to enable resume_by_ddi for IliTek touch panel.

config ILITEK_CHARGER
	bool "Enable Mediatek charging detection for IliTek touch panel"
	default n
	help
	  Say Y here if you wish to enable mediatek charging detection for IliTek touch panel.

config ILITEK_MTK_CHECK_PANEL
	bool "Enable Mediatek panel check for IliTek touch panel"
	default n
	help
	  Say Y here if you wish to enable mediatek panel check for IliTek touch panel.

config ILI_TOUCH_LAST_TIME
        bool "Get last touch timestamp on IliTek touch panel"
        default n
        help
          Say Y here if you wish to include support to get last touch timestamp on IliTek touch panel.

endif
```

## drivers/input/touchscreen/nova_0flash_mmi_v2/Kconfig
```kconfig
config TOUCHSCREEN_NVT_CHIPSET
	tristate "NovaTek Touchscreen Driver"
	default n
	help
	  Say Y here if you wish to include support for NovaTek touch panel.

	  If unsure, say N.

	  To compile this driver as a module, choose M here: the module will be called nova_0flash_mmi_v2.

if TOUCHSCREEN_NVT_CHIPSET

config NOVA_MTK_CHECK_PANEL
	bool "Enable Mediatek panel check for NovaTek touch panel"
	default n
	help
	  Say Y here if you wish to enable mediatek panel check for NovaTek touch panel.

config NVT_MTK_SPI
	bool "Update SPI timing on NovaTek touch panel"
	default n
	help
	  Say Y here if you wish to include support to update SPI timing on NovaTek touch panel.

config NOVA_TOUCH_LAST_TIME
	bool "Get last touch timestamp on NovaTek touch panel"
	default n
	help
	  Say Y here if you wish to include support to get last touch timestamp on NovaTek touch panel.

config NVT_LCM_ESD_NOTIFIER
	bool "Support LCM ESD Notifier on NovaTek touch panel"
	default n
	help
	  Say Y here if you wish to include support for LCM ESD notifier on NovaTek touch panel.

config NVT_ESD_RST_SUPPORT
	bool "Support ESD trigger to reset IC"
	default n
	help
	  Say Y here if you wish to include support for ESD trigger to reset IC on NovaTek touch panel.

config NVT_ESD_RECOVERY_SUPPORT
	bool "Support ESD recovery mechanism"
	default n
	help
	  Say Y here if you wish to include support for ESD recovery mechanism on NovaTek touch panel.

config NOVA_CHECK_DEVICE_BOOTMODE
	bool "Support charger bootmode check"
	default n
	help
	  Say Y here if you wish to include support for charger bootmode check on NovaTek touch panel.

endif
```

## drivers/misc/sx937x/Kconfig
```kconfig
#
# CapSense(TM) devices
#

config SARSENSOR_SX937X
	tristate "sx937x Programming Driver"
	depends on I2C
	default n
	help
	  CapSense devices is the analog system contains the capacitive sensing
	  hardware. Several hardware algorithms are supported. This hardware
	  performs capacitive sensing and scanning without requiring external
	  components. It contains internal flash memory, which have to be programmed
	  with firmware using HSSP interface. Host Sourced Serial Programming (HSSP)
	  refers to the programming of the target device on the board by using a host
	  microcontroller. The PSoC 4 target is programmed through the SWD interface -
	  ARM Serial Ware Debug. This option enables firmware programming driver and
	  allows automatically identify device and matching firmware. See file
	  Documentation/devicetree/bindings/misc/capsense_hssp.txt for details.

if SARSENSOR_SX937X

config CONFIG_CAPSENSE_USB_CAL
	bool "Enable sx937x usb calibration"
	default n
	help
	  Enable Cap-sensor calibration when usb plug.

	  To use SX937X_USB_CAL open the feature that it can enable cap-sensor calibration
	  when usb plug.

config SX937X_MTK_KERNEL5XX_CHARGER_TYPE
	bool "Enable sx937x Kernel 5.x charger type"
	default n
	help
	  Use Mediatek Kernel 5.x charger type for sx937x.

endif
```

## drivers/moto_f_mass_storage/Kconfig
```kconfig
config MOTO_F_MASS_STORAGE
	tristate "Moto MASS_STORAGE extension"
	default n
	help
	  Say Y here if you have a MOTO MASS STORAGE compatible
	  device connected.

	  This driver can also be built as a module. If so, the module
	  will be called moto_f_mass_storage.
```

## drivers/power/Kconfig
```kconfig
# SPDX-License-Identifier: GPL-2.0-only
source "drivers/power/bq25980_mmi/Kconfig"
source "drivers/power/mmi_decrete_charger_cp_qc3p/Kconfig"
source "drivers/power/qpnp_adaptive_charge/Kconfig"
source "drivers/power/sc8551_mmi/Kconfig"
source "drivers/power/reset/Kconfig"
source "drivers/power/supply/Kconfig"
```

## drivers/power/bq25980_mmi/Kconfig
```kconfig
config BQ25980_MMI
	tristate "BQ25980 MMI"
	default n
	help
	  Say Y here if you have a bq25980 compatible
	  device connected.

	  This driver can also be built as a module.  If so, the module
	  will be called bq25980_mmi.
```

## drivers/power/mmi_decrete_charger_cp_qc3p/Kconfig
```kconfig
config MMI_DECRETE_CHARGER_CP_QC3P
	tristate "Decrete CP QC3P Charger MMI"
	default n
	help
	  Say Y here if you have a mmi_decrete_charger_cp_qc3p compatible
	  device connected.

	  This driver can also be built as a module.  If so, the module
	  will be called mmi_decrete_charger_cp_qc3p.
```

## drivers/power/sc8551_mmi/Kconfig
```kconfig
config SC8551_MMI
	tristate "SC8551 MMI"
	default n
	help
	  Say Y here if you have a sc8551 compatible
	  device connected.

	  This driver can also be built as a module.  If so, the module
	  will be called sc8551_mmi.
```

## drivers/regulator/sm5109c/Kconfig
```kconfig
config MOTO_SM5109C
	tristate "WingTech SM5109C Power regulator"
	default n
	help
	  Say Y here if you wish to include support for SM5109C voltage regulator chips.

	  If unsure, say N.

	  To compile this as a module, choose M here: the module will
	  be called sm5109c.

	  
```
