## drivers/thermal/mediatek/Kconfig
```kconfig
config MTK_THERMAL
	tristate "Mediatek thermal drivers"
	depends on THERMAL_OF
	help
	  This is the option for Mediatek thermal software
	  solutions. Please enable corresponding options to
	  get temperature information from thermal sensors or
	  turn on throttle mechaisms for thermal mitigation.

if MTK_THERMAL

config MTK_SOC_THERMAL_LVTS
        tristate "LVTS (Low voltage thermal sensor) driver for Mediatek SoCs"
        depends on HAS_IOMEM
        depends on NVMEM
        depends on RESET_TI_SYSCON
        help
          Enable this option if you want to get SoC temperature
          information for Mediatek platforms. This driver
          configures LVTS thermal controllers to collect temperatures
          via ASIF interface.

config MTK_BOARD_THERMAL
	tristate "On-board NTC thermistor driver for Mediatek SoCs"
	help
	  Enable this option if you want to get PCB temperature
	  via on-board NTC for Mediatek platforms.
	  This driver reads the voltage value from TIA hardware
	  which is responsible for reading all PMIC AUXADC channels
	  sequentially. The address of TIA register for each channel
	  and temperature convert table should be specified in
	  device tree.

config MTK_PMIC_THERMAL
	tristate "PMIC thermal sensor driver for Mediatek SoCs"
	depends on MT635X_EFUSE
	help
	  Enable this option if you want to get PMIC temperature
	  for Mediatek platforms.
	  This driver reads the voltage value from PMIC AUXADC channels,
	  and converts raw value to PMIC temperature via PMIC efuse data.

config MTK_MD_THERMAL
	tristate "Mediatek Modem cooling framework"
	depends on MTK_ECCCI_DRIVER
	help
	  Enable this option to turn on modem throttle mechanisms
	  for Mediatek platforms.
	  This option depends on MTK_ECCCI_DRIVER which is the
	  IPC interface between AP SoC and modem.

config MTK_CHARGER_THERMAL
	tristate "Mediatek charger cooling framework"
	depends on MTK_CHARGER
	help
	  Enable this option to turn on charger throttle mechanisms
	  for Mediatek platforms.
	  This option depends on MTK_CHARGER which is
	  MTK charger driver.

config MTK_BACKLIGHT_THERMAL
	tristate "Mediatek backlight cooling framework"
	depends on LEDS_MTK_PWM || LEDS_MTK_DISP
	help
	  Enable this option to turn on backlight throttle mechanisms
	  for Mediatek platforms.
	  This option depends on LEDS_MTK which is
	  MTK leds driver.

config MTK_THERMAL_TRACE
	tristate "Mediatek thermal ftrace driver"
	depends on FTRACE
	depends on NET
	help
	  Enable this option if you want use ftrace for thermal
	  driver debugging on Mediatek platforms.
	  This driver creates trace points and a periodical timer
	  for network throughput calculation.

config MTK_THERMAL_INTERFACE
	tristate "Mediatek thermal interface driver"
	help
	  This driver provides the interface to get:
	  1.CPU/GPU/xPU headroom from uP.
	  2.thermal setting or policy from userspace daemon(ex:thermal policy and TTJ)
	  This driver also offer API to get cpu theraml headroom for other kernel module.

config CANCUNF_SURFACE_NTC_SUPPORT
	bool "cancunF use the surface_ntc to dtsi"
	default n
	help
	  set iio name for cancunF

config MOTO_THERMAL_CHARGER_STATE_NUM
	int "Set MOTO charger cooling state number"
	default 9
	help
	  This is to set MOTO charger cooling state number.
endif
```
