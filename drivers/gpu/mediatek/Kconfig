## drivers/gpu/mediatek/Kconfig
```kconfig
config MTK_GPU_SUPPORT
	tristate "Support MTK GPU"
	help
	  config supports MTK GPU driver
	  CONFIG_MTK_GPU_SUPPORT defines
	  The gpu driver would be built-in, as kernel module or not supported
	  MTK_GPU_VERSION would define the target HW IP

config MTK_GPU_VERSION
	string "Support MTK GPU Driver Version"
	default ""
	help
	  CONFIG_MTK_GPU_VERSION define which gpu ddk version will be used
	  It has three parts
	  1.vendor name 2.GPU architecture name 3. driver version

config MTK_GPU_COMMON_DVFS_SUPPORT
	bool "Support GPU VSync-Based DVFS Policy"
	default n
	help
	  config supports to enable GPU DVFS policy.
	  It is nice method to save power.
	  It is recommended to enable it when MTK_GPU_SUPPORT is enabled.

config MTK_GPU_SWPM_SUPPORT
	bool "Enable GPU SPM DVFS"
	default n
	help
	   config supports to make SWPM enable/disable GPU power model

config MTK_GPUFREQ_V2
	bool "MTK GPUFREQ Version 2"
	default n
	help
	  Support for gpufreq version 2.
	  CONFIG_MTK_GPUFREQ_V2 defines
	  if the gpufreq driver should go to version 2

config MTK_GPU_MT6855_SUPPORT
	tristate "Specify Mediatek GPU Platform is mt6855"
	depends on MTK_GPU_SUPPORT
	help
	  Select MediaTek GPU Platform is mt6855.
	  Set Y or M to select this feature for specific platform-mt6855,
	  and set N to disable.
	  It is additional config to separate platforms.
```

## drivers/media/platform/mtk-vcodec/Kconfig
```kconfig
config VIDEO_MEDIATEK_VCODEC_V1
	bool "Specify Mediatek Video Vcodec Platform V1"
	help
	  Select MediaTek Video Vcodec Platform V1
	  v1 folder is dvfs setting for policy 1
	  Set Y to select this feature for specific platform-V1.
	  If unsure, set N to disable.
```

## drivers/misc/mediatek/Kconfig
```kconfig
# SPDX-License-Identifier: GPL-2.0

config MTK_PLATFORM
	string "MTK platform name"

config ARCH_MTK_PROJECT
	string "MTK project name"

menu "Power, PMIC, Battery & Low Power"
source "drivers/misc/mediatek/clkbuf/Kconfig"
source "drivers/misc/mediatek/slbc/Kconfig"
source "drivers/misc/mediatek/cm_mgr/Kconfig"
source "drivers/misc/mediatek/mcupm/Kconfig"
source "drivers/misc/mediatek/dvfsrc/Kconfig"
source "drivers/misc/mediatek/dcm/Kconfig"
source "drivers/misc/mediatek/qos/Kconfig"
source "drivers/misc/mediatek/lpm/Kconfig"
source "drivers/misc/mediatek/ssc/Kconfig"
source "drivers/misc/mediatek/swpm/Kconfig"
source "drivers/misc/mediatek/power_throttling/Kconfig"
source "drivers/misc/mediatek/cpufreq_lite/Kconfig"
source "drivers/misc/mediatek/pbm/Kconfig"
source "drivers/misc/mediatek/mdpm/Kconfig"
source "drivers/misc/mediatek/pmsr/Kconfig"
endmenu # Power

menu "MultiMedia, Display, Camera"
source "drivers/misc/mediatek/iommu/Kconfig"
source "drivers/misc/mediatek/cameraisp/Kconfig"
source "drivers/misc/mediatek/cmdq/Kconfig"
source "drivers/misc/mediatek/mtk-interconnect/Kconfig"
source "drivers/misc/mediatek/mdp/Kconfig"
source "drivers/misc/mediatek/mmp/Kconfig"
source "drivers/misc/mediatek/lens/Kconfig"
source "drivers/misc/mediatek/flashlight/Kconfig"
source "drivers/misc/mediatek/imgsensor/Kconfig"
source "drivers/misc/mediatek/cam_cal/Kconfig"
source "drivers/misc/mediatek/cam_timesync/Kconfig"
source "drivers/misc/mediatek/camera_mem/Kconfig"
source "drivers/misc/mediatek/vow/Kconfig"
source "drivers/misc/mediatek/vdec_fmt/Kconfig"
source "drivers/misc/mediatek/widevine_drm/Kconfig"
source "drivers/misc/mediatek/mminfra/Kconfig"
endmenu # MultiMedia, Display, Camera

menu "Security"
source "drivers/misc/mediatek/trusted_mem/Kconfig"
source "drivers/misc/mediatek/geniezone/Kconfig"
source "drivers/misc/mediatek/masp/Kconfig"
endmenu # Security

menu "Tinysys"
source "drivers/misc/mediatek/sspm/Kconfig"
source "drivers/misc/mediatek/tinysys_scmi/Kconfig"
source "drivers/misc/mediatek/scp/Kconfig"
source "drivers/misc/mediatek/vcp/Kconfig"
endmenu # Tinysys

menu "Debug, log, trace"
source "drivers/misc/mediatek/mtprof/Kconfig"
source "drivers/misc/mediatek/sda/Kconfig"
source "drivers/misc/mediatek/subpmic/Kconfig"
source "drivers/misc/mediatek/log_store/Kconfig"
endmenu # Debug

menu "Modem & Connectivity"
source "drivers/misc/mediatek/ccci_util/Kconfig"
source "drivers/misc/mediatek/ccmni/Kconfig"
source "drivers/misc/mediatek/eccci/Kconfig"
source "drivers/misc/mediatek/btif/Kconfig"
source "drivers/misc/mediatek/connectivity/Kconfig"
source "drivers/misc/mediatek/mddp/Kconfig"
endmenu # Modem

menu "Other Peripherals"
source "drivers/misc/mediatek/typec/Kconfig"
source "drivers/misc/mediatek/extcon/Kconfig"
source "drivers/misc/mediatek/adsp/Kconfig"
source "drivers/misc/mediatek/audio_ipi/Kconfig"
source "drivers/misc/mediatek/usb_rndis/Kconfig"
source "drivers/misc/mediatek/usb20/Kconfig"
source "drivers/misc/mediatek/irtx/Kconfig"
source "drivers/misc/mediatek/pwm/Kconfig"
endmenu # Other Peripheral

menu "Config File"
config MOTO_DRDI_SUPPORT
	bool "moto drdi support"
	help
	  Used to enable moto drdi support,
	  which transfers product name/radio id etc to modem side.
	  Say Y here if you are need moto drdi support.
	  If unsure, say N

config MOTO_CCCI_SEC_SUPPORT
	bool "moto ccci sec support"
	help
	  Used to enable moto ccci security support,
	  which transfers moto security data, cid data etc to modem side.
	  Say Y here if you are need moto ccci security support.
	  If unsure, say N
endmenu # Config

menu "Sensors"
source "drivers/misc/mediatek/sensor/Kconfig"
endmenu # Sensors
```

## drivers/misc/mediatek/adsp/Kconfig
```kconfig
config MTK_AUDIODSP_SUPPORT
	tristate "MTK Audio DSP Support"
	help
	  AUDIO_DSP is a MediaTek in-house DSP which can do
	  different audio process.
	  Set Y to enable this feature.
	  If unsure, Set N to stay with legancy feature.

config MTK_AUDIODSP_DEBUG_SUPPORT
	bool "MTK Audio DSP Debug support"
	help
	  This is a debug interface for Audio DSP
	  Set Y to enable this feature.
	  Set N to disable this feature.
	  If unsure, Set N to disable it.
```

## drivers/misc/mediatek/cm_mgr/Kconfig
```kconfig
config MTK_CM_MGR
	tristate "MTK CPU Memory Latency Management"
	help
	  This kernel config can be used to enable CM_MGR. When enable
	  this option, dram opp level will be changed which will depended
	  on power table.
	  If unsure, say N.

config MTK_CM_IPI
	tristate "MTK CM use IPI"
	help
	  This kernel config can be used to enable CM IPI. When enable
	  this option, we will use ipi on system buffer to improve
	  performance and power.
	  If unsure, say N.

config MTK_CM_MGR_MT6855
	tristate "MTK CM_MGR for MT6855"
	help
	  This kernel config can be used to enable CM_MGR MT6855. When enable
	  this option, dram opp level will be changed which will depended
	  on power table.
	  If unsure, say N.
```

## drivers/misc/mediatek/connectivity/Kconfig
```kconfig
config MTK_COMBO
	tristate "MediaTek Connectivity Combo Chip Support"
	help
	  MTK connectivity combo chip driver for MT66xx
	  This config
	  is used to
	  turn on/off connsys

#
# MTK Combo Chip Selection
#

config MTK_COMBO_CHIP_CONSYS_6855
	bool "MTK MT6855 combo chip support"
	help
	  this config is used to decide SOC consys version
	  in current platform
	  is
	  MT6855(BT/WIFI/GPS/FM combo chip)

#
# MTK COMBO Chip Configuration
#

config MTK_COMBO_BT
	tristate "MediaTek Combo Chip BT driver"
	depends on MTK_COMBO
	help
	  MTK BT /dev/stpbt driver for Bluedroid

config MTK_COMBO_GPS
	tristate "MediaTek Combo Chip GPS driver"
	depends on MTK_COMBO
	help
	  MTK GPS /dev/stpgps driver

config MTK_COMBO_WIFI
	tristate "MediaTek combo chip Wi-Fi support"
	depends on MTK_COMBO
	select WIRELESS_EXT
	select WEXT_PRIV

config MTK_WIFI_MCC_SUPPORT
	bool "MTK_WIFI_MCC_SUPPORT"
	depends on MTK_COMBO_WIFI
	default y
	help
	  if it is set to TRUE, wlan will support Multi-Channel Concurrency,
	  otherwise, only support Single Channel Concurrency

config MTK_DHCPV6C_WIFI
	bool "MTK_DHCPV6C_WIFI"
	help
	  no: disable this feature

menuconfig GPS
	tristate "GPS drivers"
	help
	  Say Y here for supporting GPS.

config MTK_GPS_SUPPORT
	tristate "support MediaTek GPS driver"
	help
	  to switch GPS feature on the platform.
	  Set "yes" to turn on and set "no"
	  (with MTK_AGPS_APP=no at the same time)
	  to turn off.

config MTK_GPS_EMI
	tristate "MediaTek GPS EMI Driver"
	depends on MTK_COMBO_GPS
	help
	   GPS EMI driver is for MNL OFFLOAD feature.

config MTK_FMRADIO
	tristate "MediaTek FMRadio driver"
	depends on MTK_COMBO
	help
	  This config is used to choose
	  if need to compile fmradio folder.
	  Will compile fmradio folder if set to 'y',
	  otherwise will not compile fmradio folder.

config MTK_FM_CHIP
	string "MTK FM CHIP"
	depends on MTK_FMRADIO
	help
	  This config is used to choose
	  which FM radio chip to use:
	  e.g. MT6627_FM, MT6580_FM, MT6630_FM,
	  for control to use which platform code.

config MTK_FM_50KHZ_SUPPORT
	bool "support MTK FM 50KHZ"
	depends on MTK_FMRADIO
	help
	  This config is used to choose
	  if need to support FM 50KHz step or not
	  for tune/seek/scan functions.
	  Will support 50KHz step if set to 'y',
	  otherwise will not support 50KHz step.

config MTK_CONNSYS_DEDICATED_LOG_PATH
	bool "Enable connsys log using dedicated path"
	help
	  This will enable connsys log using dedicated path
	  1. There would be a common debug utility for collecting log
	     from connsys (by EMI or other specific path)
	  2. The scope may include (but not limited) Wi-Fi firmware log,
	     BT firmware log, GPS firmware log etc.
```

## drivers/misc/mediatek/dvfsrc/Kconfig
```kconfig
config MTK_DVFSRC_HELPER
	tristate "MTK DVFSRC Helper debugging Support"
	depends on MTK_DVFSRC
	help
	  This kernel config can be used to debug dvfsrc (dynamic voltage
	  and frequency scaling resource collector) for Mediatek vcore_dvfs.
	  When enable this option, we can trace the control flow for dvfsrc
	  and dump current vcore and dram information.
	  If unsure, say N.
```

## drivers/misc/mediatek/flashlight/Kconfig
```kconfig
#
# Flashlight device configuration
#

config MTK_FLASHLIGHT
	tristate "Mediatek flashlight driver"
	help
	  This is flashlight driver for camera.

	  Say Y here if you want a flashlight core to handle flashlight devices.
	  If you have any questions about this, say Y here,
	  only say N if you know exactly what you are doing.


config MTK_V4L2_FLASHLIGHT
	tristate "Mediatek V4L2 flashlight driver"
	help
	  Say Y to enable V4L2 flashlight device
	  This Framework is good for
	  controling flashlight Leds.
	  Say N to disable V4L2 flashlight.

	  Say M here if you want to compile this driver as a module.

config MTK_FLASHLIGHT_CANCUNF
	tristate "Mediatek flashlight cancunf pwm driver"
	depends on MTK_FLASHLIGHT
	default n
	help
	  This is flashlight cancunf pwm driver for camera.

	  Say Y here if you want a cancun driver IC with GPIO interface.
	  Select this only if your board has this IC.

	  Say M here if you want to compile this driver as a module.

config MTK_FLASHLIGHT_PT
	bool "Mediatek flashlight power throttling"
	depends on MTK_FLASHLIGHT
	help
	  This is for flashlight power throttling.

	  Power throttling will limit flashlight function,
	  such as disable flashlight, decrease brightness level or
	  change flash mode to torch mode.

config MTK_FLASHLIGHT_PT_STRICT
	bool "Mediatek flashlight power throttling (strict)"
	depends on MTK_FLASHLIGHT_PT
	help
	  This is for flashlight strict power throttling.

	  Strict power throttling will disable flashlight when
	  over-current, low battary voltage and low battary percentage
	  situations.

config MTK_FLASHLIGHT_DLPT
	bool "Mediatek flashlight dynamic low power throttling"
	depends on MTK_FLASHLIGHT
	help
	  This is for flashlight dynamic low power throttling.

	  Dynamic low power throttling is a mechanism to monitor
	  the current of battary dynamicly. It will start by request
	  and notice user by kernel notifier.
```

## drivers/misc/mediatek/geniezone/gz-trusty/Kconfig
```kconfig
menu "GZ Trusty"


config HAVE_MTK_GZ_LOG
	bool "GZ gz_log & trusty_log support"
	help
	  This symbol is used to build gz_log into kernel.
	  The gz_log driver will create a proc node which can only printthe gz
	  message.
	  It will be select if MTK_ENABLE_GENIEZONE is on.
	  If the gz_log driver failed or this symbol is false, the mtk logger
	  can not read the gz message correctly.

config TRUSTY_INTERRUPT_FIQ_ONLY
	bool "GZ Trusty interrupt fiq support"
	help
	  This is used for Trusty to support handling new flow in GICv3
	  If this is selected, NWd will not route IRQ to Secure OS
	  but just fire NOP.
	  This is MUST for us to handle G0S IRQ for Secure OS.

endmenu

# GZ Trusty
```

## drivers/misc/mediatek/imgsensor/Kconfig
```kconfig
config MTK_IMGSENSOR
	tristate "MediaTek image sensor support"
	help
	  This is a driver for the MediaTek
	  image sensors.
	  To compile this driver as a module, choose M here: the
	  module will be called imgsensor_isp6s.

config CUSTOM_KERNEL_IMGSENSOR
	string "Custom image sensor driver"
	help
	  Kernel space image sensor driver. Define  project used all image
	  sensors .The value is combination of CUSTOM_KERNEL_MAIN_IMGSENSOR,
	  CUSTOM_KERNEL_MAIN_BACKUP_IMGSENSOR, CUSTOM_KERNEL_SUB_IMGSENSOR,
	  and CUSTOM_KERNEL_SUB_BACKUP_IMGSENSOR

source "drivers/misc/mediatek/imgsensor/src/Kconfig"
```

## drivers/misc/mediatek/imgsensor/src/Kconfig
```kconfig
config  MOT_CANCUNF_CAMERA_PROJECT
        tristate "set cancun camera driver"
        help
          Used to distinguish project-driver code from other projects.
```

## drivers/misc/mediatek/lens/Kconfig
```kconfig
config MTK_LENS
	tristate "Mediatek lens driver"
	help
	  This is lens driver for camera
	  Say Y here if you want to enable lens driver.
	  If you have any questions about this, say Y here,
	  only say N if you know exactly what you are doing.
```

## drivers/misc/mediatek/lpm/Kconfig
```kconfig
config MTK_LOW_POWER_MODULE
	tristate "Meditaek Low Power Module"
	help
	  For MediaTek Low Power Module, such as CPU idle,
	  CPU suspend low power enhencement.
	  Select "y" if you want to enable low power features.
	  Select "n" if unsure.

config MTK_LPM_DBG_COMMON
	bool "Meditaek Low Power common debug Module"
	help
	  Select MTK_LPM_DBG_COMMON then Mediatek low module
	  common debug feature will be enabled. The common debug
	  feature will support basic debug control and show the
	  information to console.


config MTK_LPM_GS_DUMP_SUPPORT
	bool "Meditaek Low Power golden setting checker"
	help
	  Select MTK_LPM_GS_DUMP_SUPPORT then Mediatek low module
	  golden setting dump mechanism enable.
	  Select "y" if you want to enable gs dump features.
	  Select "n" if unsure.

config MTK_LPM_GS_DUMP_VERSION
	string "Meditaek Low Power golden setting checker version"
	default "v1"
	help
	  Set MTK_LPM_GS_DUMP_VERSION for Mediatek low module
	  golden setting dump mechanism version.

config MTK_LPM_MT6855
	tristate "Specify Mediatek LPM Platform is MT6855"
	depends on MTK_LOW_POWER_MODULE
	select MTK_LPM_DBG_COMMON
	help
	  Select MediaTek Low Power Module Platform is MT6855
	  for power management.
	  Set Y to select this feature for specific platform-mt6855.
	  If unsure, set N to disable.
```

## drivers/misc/mediatek/masp/Kconfig
```kconfig
config MTK_SECURITY_SW_SUPPORT
	tristate "Mediatek Security SW Support"
	help
	  This is the driver for MediaTek kernel security.
	  This module contains the random id and dm-verity handle functions
	  To compile this driver as a module, choose M here: the
	  module will be called masp.
```

## drivers/misc/mediatek/mdp/Kconfig
```kconfig
config MTK_MDP
	tristate "enable MDP driver extension"
	help
	  This extension enable debug feature, such as mdp-status,
	  cmdq-record, pre-dump, timeout error dump, first error buffer
	  and aee db. Enable performance tools which add instruction
	  inside packet and profiling.
```
