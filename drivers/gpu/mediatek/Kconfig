## drivers/misc/mediatek/slbc/Kconfig
```kconfig
config MTK_SLBC
	tristate "MTK SLBC"
	help
	  This kernel config can be used to enable SLBC. When enable
	  this option, we will use system buffer to improve performance
	  and power.
	  If unsure, say N.
```

## drivers/misc/mediatek/subpmic/Kconfig
```kconfig
config MTK_SUBPMIC_MISC
	tristate "Mediatek Subpmic Miscellaneous"
	help
	  Enable to support Mediatek subpmic miscellaneous functions.
	  For example, customized debugfs for different chips.
	  Other platform dependent operations,
	  e.g., communication between modem and AP.
```

## drivers/misc/mediatek/trusted_mem/Kconfig
```kconfig
# SPDX-License-Identifier: GPL-2.0
#
# Copyright (C) 2018 MediaTek Inc.
#

config MTK_SECURE_MEM_SUPPORT
	bool "MTK SVP SECURE Memory Support"
	default y
	depends on TRUSTONIC_TEE_SUPPORT || MTK_TEE_GP_SUPPORT || MTK_GZ_KREE
	help
	  Enable the support of MediaTek SVP secure memory driver.
	  This driver is in charge of SVP secure memory region require/release
	  from SSMR and also the memory allocation/free requests from ION.
	  It is a proxy of TEE secure memory driver for SVP secure memory
	  management.
	  Say Y if you would like to enable this feature.
	  If unsure, say N.

config MTK_WFD_SMEM_SUPPORT
	bool "MTK WFD SECURE Memory Support"
	default y
	depends on MTK_SECURE_MEM_SUPPORT
	help
	  Enable the support of MediaTek WFD secure memory driver.
	  This driver is in charge of WFD secure memory region require/release
	  from SSMR and also the memory allocation/free requests from ION.
	  It is a proxy of TEE secure memory driver for WFD secure memory
	  management.
	  Say Y if you would like to enable this feature.
	  If unsure, say N.

config MTK_TRUSTED_MEMORY_SUBSYSTEM
	tristate "MTK Trusted Memory Subsystem Support"
	default m
	depends on MTK_PROT_MEM_SUPPORT || MTK_SECURE_MEM_SUPPORT || \
			   MTK_MTEE_MULTI_CHUNK_SUPPORT || MTK_GZ_KREE
	select CMA
	select DMA_CMA
	help
	  Enable the support of MediaTek trusted memory subsystem driver.
	  This driver provide a general subsystem layer for trusted peer memory
	  manager such as EL2 hypervisor or TEE. New type of trusted memory can
	  be registered to this subsystem easily.
	  Say Y if you would like to build it in kernel image.
	  Say M if you would like to build it as a kernel module.
	  If unsure, say N.
```

## drivers/misc/mediatek/typec/tcpc/Kconfig
```kconfig
#
# TypeC Port Controller Device Configuration
#

config TCPC_CLASS
	tristate "TypeC Port Controller Device Class"
	select MTK_USB_TYPEC
	select OF
	select TYPEC
	help
	  Say Y to enable
	  Typec Port
	  Controller Device
	  Class

config USB_POWER_DELIVERY
	tristate "Support USB power delivery Function"
	depends on TCPC_CLASS
	help
	  Say Y to enable
	  USB
	  Power Delivery
	  support

config TCPC_MT6375
	tristate "Mediatek MT6375 Type-C chip driver"
	depends on TCPC_CLASS
	depends on MFD_MT6375
	help
	  Say Y to enable MediaTek MT6375
	  Mediatek MT6375 Type-C chip driver that works with
	  Type-C Port Controller Manager to provide USB PD and USB
	  Type-C functionalities.

config DISABLE_SUPPORT_MMI_ADAPTER
        bool "disable MMI private PD protocol"
        default n
        help
          Say Yes to disable MMI pd protocl.
          It is mainly used as pd charger

config USB_PD_VBUS_STABLE_TOUT
	int "PD VBUS Stable Timeout"
	depends on USB_POWER_DELIVERY
	range 0 1000                       # >= 0,  <= 1000
	default 125
	help
	  Setup a timeout value (ms)
	  for
	  VBUS change
	  stable

config PD_DBG_INFO
	tristate "PD debug information"
	depends on TCPC_CLASS
	default y
	help
	  Say Y to enable PD debug
	  for PD DBG
	  information
	  Say N to disable

config MTK_TYPEC_WATER_DETECT
	tristate "Water detection function for type-c connector"
	depends on TCPC_CLASS
	help
	  Say Yes to enable water detection on type-c connector.
	  If water is detected on the connector, it will show
	  warning to notify end user.
	  If unsure, say N.
```

## drivers/misc/mediatek/usb20/Kconfig
```kconfig
config USB_MTK_HDRC
	tristate "MediaTek MUSB support"
	select USB_GADGET_SELECTED
	select USB_GADGET_DUALSPEED
	help
	  Say Y here if your system has a high speed USB
	  controller based on the MTK MUSB IP.  Then
	  configure options to match your silicon and the board
	  it's being used with, including the USB peripheral role,
	  or the USB host role, or both.

config MTK_MUSB_QMU_SUPPORT
	bool "QMU Transfer mode of MediaTek MUSB"
	depends on USB_MTK_HDRC
	help
	  Say Y here if your system has a QMU capability for USB
	  controller based on the MTK MUSB IP.
	  QMU is some kind of enhanced DMA mode by HW queeu rather
	  than SW queue to reduce SW effort.

config MTK_MUSB_QMU_PURE_ZLP_SUPPORT
	bool "Transfer ZLP by GDP of MediaTek MUSB"
	depends on MTK_MUSB_QMU_SUPPORT
	help
	  Say Y here if QMU IP supports sending zero
	  length packet(ZLP) by setting ZLP flag in GDP
	  and the driver can enable by internal register.
	  After MT6763 should support this feature.

config MTK_MUSB_DRV_36BIT
	bool "MediaTek MUSB 36bits addressing support"
	default n
	help
	  This selects the MediaTek MUSB support 36-bits
	  address accessing.
	  Say Y here if you want to enable 36-bits addressing support.
	  If unsure, say N.

config USB_MTK_OTG
	bool "MediaTek MUSB OTG support"
	help
	  Enable Mediatek USB Host OTG detection mechanism
	  and USB-IF Compliance Test Program.
	  1. IDDIG - OTG cable attachment detection.
	  2. DRVVBUS - provides the VBUS for the attached devices

config MTK_MUSB_CARPLAY_SUPPORT
	bool "MediaTek MUSB Carplay support"
	help
	  Say Y here if your want to use carplay.

config MTK_MUSB_DUAL_ROLE
	bool "Mediatek MUSB Dual Role mode support"
	select USB_ROLE_SWITCH
	help
	  This is the default mode of working of MTK MUSB controller
	  where both host and gadget
	  features are enabled.
	  It is better to be used with Mediatek extcon and tphy support.
	  Say Y here if your want to use usb role switch.
```

## drivers/misc/mediatek/vcp/Kconfig
```kconfig
config MTK_TINYSYS_VCP_SUPPORT
	tristate "Specify Interface Support VCP"
	help
	  VCP is a MediaTek in-house DSP which can receive
	  command from IPI interface.
	  Set Y to enable this feature.
	  If unsure,
	  Set N to stay with legancy feature.
```

## drivers/misc/mediatek/vow/Kconfig
```kconfig
config MTK_VOW_SUPPORT
	tristate "MediaTek VOW support"
	help
	  For VOW kernel driver config. This voice wakeup
	  kernel driver cooperate with SCP VOW driver to
	  wakeup phone by doing voice recognition. Using
	  IPI interface to communicate with SCP side and
	  be controlled by sound trigger HAL.

config MTK_VOW_BARGE_IN_SUPPORT
	bool "Support VOW barge-in"
	help
	  Only enable this when we support VOW and barge-in.
	  This improves the hot word recognition accuracy by
	  applying echo cancellation to remove speaker output signal.
	  Select Y to enable CONFIG_MTK_VOW_BARGE_IN_SUPPORT for
	  barge-in feature.

config MTK_VOW_GVA_SUPPORT
	bool "MediaTek VOW Google keyword support"
	help
	  For VOW kernel driver config. This config can
	  reserve Google voice assistant, and work with SCP
	  and sound trigger HAL. It can report Google keyword
	  wakeup status to HAL. This feature need to work
	  with MTK_VOW_SUPPORT.

config MTK_VOW_MAX_PDK_NUMBER
	int "MediaTek VOW MAX PDK model support"
	default 0
	help
	  For VOW kernel driver config. This config can
	  support different PDK model number, and work with SCP
	  and sound trigger HAL. This feature need to work
	  with MTK_VOW_SUPPORT.

config MTK_VOW_DSP_VERSION
	string "MediaTek VOW DSP Version"
	help
	  For VOW kernel driver config. This config can
	  indicate DSP version. This feature need to work
	  with MTK_VOW_SUPPORT.
```

## drivers/scsi/ufs/vendor/Kconfig
```kconfig
config UFSFEATURE
	bool "UFS feature activate"
	depends on SCSI_UFSHCD
	help
	  UFS feature activate such as hpb, tw and etc.

config UFSHID
	bool "UFS Host Initiated Defrag support"
	depends on SCSI_UFSHCD && UFSFEATURE
	help
	  UFS HID Feature Enable

config MICRON_UFSHID
	bool "Micron UFS Host Initiated Defrag support"
	depends on SCSI_UFSHCD && UFSFEATURE
	help
	  Micron UFS HID Feature Enable

config SCSI_SKHID
	bool "UFS Host Initiated Defrag supportr"
	depends on (SCSI_UFSHCD || SCSI_UFSHCD_QTI)
	help
	  Activate or deactive SKHID driver

config UFSHID_POC
	bool "UFSHID_POC test"
	depends on SCSI_UFSHCD && UFSFEATURE && UFSHID
	help
	  UFS HID POC test
	  1. block to enter suspend state
	  2. auto_hibern8 enable/disable (HCI)
	  3. set flag bDefragOperation
	  4. debug msg enable (default : disable)

config UFSHID_DEBUG
	bool "HID Debug Enable"
	depends on SCSI_UFSHCD && UFSFEATURE && UFSHID
	default n
	help
	UFS HID Debug Enable (for check io stat during trigger)

config UFSRINGBUF
	bool "UFS RingBuffer support"
	depends on SCSI_UFSHCD && UFSFEATURE
	help
	  UFS RingBuffer Feature Enable

config UFSRINGBUF_POC
	bool "UFS RingBuffer POC test"
	depends on SCSI_UFSHCD && UFSFEATURE && UFSRINGBUF
	help
	  UFS RingBuffer POC test
	  1. set default vendor_signature & vendor_parameter for test
	  2. Set custom vender_parameter
```

## drivers/tee/gud/510/Kconfig
```kconfig
#
# Trustonic drivers configuration
#
config TRUSTONIC_TEE
	tristate "Trustonic TEE Driver"
	depends on ARM || ARM64
	default y
	help
	  Enable Trustonic TEE Support.
	  This option enables MobiCore Driver which is used to communicate with
	  TEE OS, for things like, setting up log buffers, interrupt pins,
	  and IPC channels.
```

## drivers/tee/gud/Kconfig
```kconfig
#
# TRUSTONIC TEE configuration
#
config TRUSTONIC_TEE_SUPPORT
	tristate "Enable Trustonic TEE Support"
	help
	  Enable Trustonic TEE Support.
	  This option enables MobiCore Driver which is used to communicate with
	  TEE OS, for things like, setting up log buffers, interrupt pins,
	  and IPC channels.

config TRUSTONIC_TEE_VERSION
	string "TRUSTONIC TEE Version"
	depends on TRUSTONIC_TEE_SUPPORT
	default "510"

config FSCRYPT_WRAPED_KEY_MODE_SUPPORT
	bool "Wrapped Key support for FSCRYPT V2"
	depends on TRUSTONIC_TEE_SUPPORT
	help
	  Enable Fscrypt V2 wrapped key support
	  This option enables keymaster in mobicore drive which is used to communicate with
	  TEE OS, for things like, wrapped key programming, wrapped key derivation,
	  and key unwrapping.
```
